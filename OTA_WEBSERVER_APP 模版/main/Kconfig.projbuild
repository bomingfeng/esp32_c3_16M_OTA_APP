## OTA_WEBSERVER_APP 模版/main/Kconfig.projbuild
```kconfig
menu "Example Configuration"

config STATION_SSID
    string "Station SSID"
	default "fengboming"
	help
		SSID (network name) for the example to connect to.

config STATION_PASSPHRASE
    string "Station Passphrase"
	default "bomingfeng1"
	help
		WiFi password (WPA or WPA2) for the example to use.
		Can be left blank if the network has no security set.

config AP_SSID
    string "AP SSID"
	default "ESP32-C3 OTA"
	help
		AP SSID (network name) for the ESP32 to act as a AP

config AP_PASSPHARSE
    string "AP Passphrase"
	default "12345678"
	help
		AP password (WPA or WPA2) to use.
		Can be left blank if the network has no security set.

    config INPUT_GPIO
        int "INPUT GPIO number"
        range 0 34
        default 8
        help
            GPIO number (IOxx) to INPUT high and low.
            Some GPIOs are used for other purposes (flash connections, etc.) and cannot be used to INPUT.
            GPIOs 35-39 are input-only so cannot be used as outputs.

endmenu
```

## OTA_WEBSERVER_APP_Air_conditioner_controller/main/Kconfig.projbuild
```kconfig
menu "Example Configuration"

config STATION_SSID
    string "Station SSID"
	default "fengboming"
	help
		SSID (network name) for the example to connect to.

config STATION_PASSPHRASE
    string "Station Passphrase"
	default "bomingfeng1"
	help
		WiFi password (WPA or WPA2) for the example to use.
		Can be left blank if the network has no security set.

config AP_SSID
    string "AP SSID"
	default "ESP32-C3 OTA"
	help
		AP SSID (network name) for the ESP32 to act as a AP

config AP_PASSPHARSE
    string "AP Passphrase"
	default "12345678"
	help
		AP password (WPA or WPA2) to use.
		Can be left blank if the network has no security set.

    config INPUT_GPIO
        int "INPUT GPIO number"
        range 0 34
        default 10
        help
            GPIO number (IOxx) to INPUT high and low.
            Some GPIOs are used for other purposes (flash connections, etc.) and cannot be used to INPUT.
            GPIOs 35-39 are input-only so cannot be used as outputs.

    config EXAMPLE_RMT_TX_GPIO
        int "RMT TX GPIO"
        default 6
        help
            Set the GPIO number used for transmitting the RMT signal.

    config EXAMPLE_RMT_RX_GPIO
        int "RMT RX GPIO"
        default 1
        help
            Set the GPIO number used for receiving the RMT signal.

    config DS18B20_SENSOR_GPIO
        int "DS18B20 GPIO"
        default 8
        help
            Set the GPIO number used for receiving the RMT signal.

    config DS18B20_SENSOR_MAX
        int "DS18B20 MAX"
        default 1
        help
            Set the GPIO number used for receiving the RMT signal.

    choice EXAMPLE_IP_MODE
        prompt "IP Version"
        depends on EXAMPLE_SOCKET_IP_INPUT_STRING
        help
            Example can use either IPV4 or IPV6.

        config EXAMPLE_IPV4
            bool "IPV4"

        config EXAMPLE_IPV6
            bool "IPV6"

    endchoice

    config AP_EXAMPLE_IPV4_ADDR
        string "AP IPV4 Address"
        default "192.168.0.2"
        depends on EXAMPLE_IPV4
        help
            The example will connect to this AP IPV4 address.

    config EXAMPLE_IPV4_ADDR
        string "IPV4 Address"
        default "192.168.1.106"
        depends on EXAMPLE_IPV4
        help
            The example will connect to this IPV4 address.

    config EXAMPLE_IPV6_ADDR
        string "IPV6 Address"
        default "FE80::30AD:E57B:C212:68AD"
        depends on EXAMPLE_IPV6
        help
            The example will connect to this IPV6 address.

    config EXAMPLE_PORT
        int "Port"
        range 0 65535
        default 6800
        help
            The remote port to which the client example will connect to.

    choice EXAMPLE_SOCKET_IP_INPUT
        prompt "Socket example source"
        default EXAMPLE_SOCKET_IP_INPUT_STRING
        help
            Selects the input source of the IP used in the example.

        config EXAMPLE_SOCKET_IP_INPUT_STRING
            bool "From string"

        config EXAMPLE_SOCKET_IP_INPUT_STDIN
            bool "From stdin"
    endchoice

endmenu
```
